## kernel/Kconfig
```kconfig
menuconfig MEDIATEK_SOLUTION
        bool "MediaTek Properitary Configuration"
        help
            Check this to enable MediaTek properity configuration.

if MEDIATEK_SOLUTION

config ARCH_MTK_PLATFORM
  string
  option env="ARCH_MTK_PLATFORM"

choice 
    bool "System Type"

source "../mediatek/platform/$ARCH_MTK_PLATFORM/kernel/Kconfig/Platform"

endchoice

config HAVE_MTK_TEE_SUPPORT
	def_bool n

config MTK_TEE_SUPPORT
	bool "Enable MTK In House TEE Support"
	depends on HAVE_MTK_TEE_SUPPORT
	default n
	help
	  This enable MTK TEE support.

source "../mediatek/platform/$ARCH_MTK_PLATFORM/kernel/Kconfig/Kernel"
source "../mediatek/platform/$ARCH_MTK_PLATFORM/kernel/Kconfig/Board"
source "../mediatek/platform/$ARCH_MTK_PLATFORM/kernel/Kconfig/Drivers"

endif

config MTK_THERMAL_STATUS_COLLECTION
        bool "MTK Thermal Status Information Collection"
        default n


config MD32_SUPPORT
	bool "Specifiy If Platform Support MD32"
	default n
```
